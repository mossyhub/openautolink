## hfp_helper/firmware/sdkconfig.defaults
```kconfig
# Project defaults — applied to sdkconfig on first build.
# Tweak via `idf.py menuconfig`; commit changes here for reproducibility.

# Target: ESP32-S3 only (TinyS3).
CONFIG_IDF_TARGET="esp32s3"

# === Bluetooth: Bluedroid in dual-mode (BR/EDR + LE) ===
CONFIG_BT_ENABLED=y
CONFIG_BT_BLUEDROID_ENABLED=y
CONFIG_BT_CONTROLLER_ENABLED=y
CONFIG_BT_BR_EDR_HOST_ENABLED=y
CONFIG_BT_BLE_ENABLED=y

# HFP Hands-Free unit role (HF), not Audio Gateway (AG).
CONFIG_BT_HFP_ENABLE=y
CONFIG_BT_HFP_CLIENT_ENABLE=y
CONFIG_BT_HFP_AG_ENABLE=n
# Audio path: PCM data event (PCM bytes come up to firmware), not codec offload.
CONFIG_BT_HFP_AUDIO_DATA_PATH_HCI=y
# Enable wideband speech (mSBC). CVSD will be used when remote doesn't support mSBC.
CONFIG_BT_HFP_WBS_ENABLE=y

# Reduce SDP entries we don't need.
CONFIG_BT_SDP_COMMON_ENABLED=y

# === BLE GATT server for WiFi provisioning ===
CONFIG_BT_GATTS_ENABLE=y
CONFIG_BT_GATTC_ENABLE=n

# === WiFi ===
CONFIG_ESP_WIFI_DYNAMIC_TX_BUFFER=y
CONFIG_ESP_WIFI_DYNAMIC_RX_BUFFER=y
# We're a station, not an AP.
CONFIG_ESP_WIFI_SOFTAP_SUPPORT=n

# === PSRAM (TinyS3 has 8MB octal PSRAM) ===
CONFIG_SPIRAM=y
CONFIG_SPIRAM_MODE_OCT=y
CONFIG_SPIRAM_SPEED_80M=y
CONFIG_SPIRAM_TYPE_AUTO=y
# Allow BSS in PSRAM so BT/WiFi stacks have room to breathe.
CONFIG_SPIRAM_USE_MALLOC=y
CONFIG_SPIRAM_TRY_ALLOCATE_WIFI_LWIP=y

# === Partitions: custom table with OTA support ===
CONFIG_PARTITION_TABLE_CUSTOM=y
CONFIG_PARTITION_TABLE_CUSTOM_FILENAME="partitions.csv"

# === Logging ===
CONFIG_LOG_DEFAULT_LEVEL_INFO=y
CONFIG_LOG_COLORS=y

# === USB CDC for serial logging (TinyS3 has no UART-to-USB chip; uses native USB) ===
CONFIG_ESP_CONSOLE_USB_CDC=y

# === Misc ===
CONFIG_FREERTOS_HZ=1000
CONFIG_COMPILER_OPTIMIZATION_SIZE=y
CONFIG_ESP_TASK_WDT_INIT=y
CONFIG_ESP_TASK_WDT_TIMEOUT_S=10
```
